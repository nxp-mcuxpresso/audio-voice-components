## Kconfig
```kconfig
menu "Components"
    osource "middleware/audio_voice/components/decoders/Kconfig"
    osource "middleware/audio_voice/components/encoders/Kconfig"
    osource "middleware/audio_voice/components/ogg/Kconfig"
    osource "middleware/audio_voice/components/opus/Kconfig"
    osource "middleware/audio_voice/components/opusfile/Kconfig"
    osource "middleware/audio_voice/components/asrc/Kconfig"
    osource "middleware/audio_voice/components/ssrc/Kconfig"
    osource "middleware/audio_voice/components/vit/Kconfig"
    osource "middleware/audio_voice/components/voice_spot/Kconfig"
endmenu
```

## asrc/Kconfig
```kconfig
config MCUX_COMPONENT_middleware.audio_voice.components.asrc
    bool "Asynchronous Sample Rate Converter"
```

## decoders/Kconfig
```kconfig
menu "Decoders"
    osource "middleware/audio_voice/components/decoders/aac/Kconfig"
    osource "middleware/audio_voice/components/decoders/flac/Kconfig"
    osource "middleware/audio_voice/components/decoders/mp3/Kconfig"
    osource "middleware/audio_voice/components/decoders/wav/Kconfig"
endmenu
```

## decoders/aac/Kconfig
```kconfig
config MCUX_COMPONENT_middleware.audio_voice.components.decoders.aac
    bool "AAC decoder"
```

## decoders/flac/Kconfig
```kconfig
config MCUX_COMPONENT_middleware.audio_voice.components.decoders.flac
    bool "Flac decoder"
```

## decoders/mp3/Kconfig
```kconfig
config MCUX_COMPONENT_middleware.audio_voice.components.decoders.mp3
    bool "MP3 decoder"
```

## decoders/wav/Kconfig
```kconfig
config MCUX_COMPONENT_middleware.audio_voice.components.decoders.wav
    bool "WAV decoder"
```

## ogg/Kconfig
```kconfig
config MCUX_COMPONENT_middleware.audio_voice.components.ogg
    bool "Ogg"
    default n
```

## opus/Kconfig
```kconfig
config MCUX_COMPONENT_middleware.audio_voice.components.opus
    bool "Opus"
    default n
```

## opusfile/Kconfig
```kconfig
config MCUX_COMPONENT_middleware.audio_voice.components.opusfile
    bool "Opus file"
    default n
```

## ssrc/Kconfig
```kconfig
config MCUX_COMPONENT_middleware.audio_voice.components.ssrc
    bool "Synchronous Sample Rate Converter"
```

## zephyr/Kconfig
```kconfig
# Copyright 2024 NXP
# SPDX-License-Identifier: BSD-3-Clause

menu "NXP audio voice libraries"

    config NXP_AUDIO_VOICE_COMPONENTS_ALL
        bool "Enables all"
        default n
        select NXP_AUDIO_VOICE_COMPONENTS_SSRC
        select NXP_AUDIO_VOICE_COMPONENTS_ASRC
        select NXP_AUDIO_VOICE_COMPONENTS_OPUS
        select NXP_AUDIO_VOICE_COMPONENTS_OPUS_OGG
        select NXP_AUDIO_VOICE_COMPONENTS_OPUSFILE
        select NXP_AUDIO_VOICE_COMPONENTS_DECODER_AAC
        select NXP_AUDIO_VOICE_COMPONENTS_DECODER_FLAC
        select NXP_AUDIO_VOICE_COMPONENTS_DECODER_MP3
        select NXP_AUDIO_VOICE_COMPONENTS_DECODER_WAV

    config NXP_AUDIO_VOICE_COMPONENTS_DECODERS_ALL
        bool "Enables all decoders"
        default n
        select NXP_AUDIO_VOICE_COMPONENTS_DECODER_AAC
        select NXP_AUDIO_VOICE_COMPONENTS_DECODER_FLAC
        select NXP_AUDIO_VOICE_COMPONENTS_DECODER_MP3
        select NXP_AUDIO_VOICE_COMPONENTS_DECODER_WAV
        select NXP_AUDIO_VOICE_COMPONENTS_OPUS
        select NXP_AUDIO_VOICE_COMPONENTS_OPUS_OGG
        select NXP_AUDIO_VOICE_COMPONENTS_OPUSFILE

    config NXP_AUDIO_VOICE_COMPONENTS_ENCODERS_ALL
        bool "Enables all encoders"
        default n
        select NXP_AUDIO_VOICE_COMPONENTS_OPUS
        select NXP_AUDIO_VOICE_COMPONENTS_OPUS_OGG
        select NXP_AUDIO_VOICE_COMPONENTS_OPUSFILE

    config NXP_AUDIO_VOICE_COMPONENTS_ENCODERS_DECODERS_ALL
        bool "Enables all both Encoder&Decoder libs"
        default n
        select NXP_AUDIO_VOICE_COMPONENTS_OPUS
        select NXP_AUDIO_VOICE_COMPONENTS_OPUS_OGG
        select NXP_AUDIO_VOICE_COMPONENTS_OPUSFILE

    config NXP_AUDIO_VOICE_COMPONENTS_LIBRARIES_ALL
        bool "Enables all libraries"
        select NXP_AUDIO_VOICE_COMPONENTS_SSRC
        select NXP_AUDIO_VOICE_COMPONENTS_ASRC

    config NXP_AUDIO_VOICE_COMPONENTS_TARGET_DEBUG
        bool "Adds libraries with debug symbols enabled"
        default n

    menu "Decoders"
        config NXP_AUDIO_VOICE_COMPONENTS_DECODER_AAC
            bool "Enables AAC decoder"
            default n

        config NXP_AUDIO_VOICE_COMPONENTS_DECODER_FLAC
            bool "Enables FLAC decoder"
            default n

        config NXP_AUDIO_VOICE_COMPONENTS_DECODER_MP3
            bool "Enables MP3 decoder"
            default n

        config NXP_AUDIO_VOICE_COMPONENTS_DECODER_WAV
            bool "Enables WAV decoder"
            default n
    endmenu # "Decoders"

    menu "Encoders"
    endmenu

    menu "Both Encoder&Decoder libs"
        config NXP_AUDIO_VOICE_COMPONENTS_OPUS
            bool "Enables OPUS encoder/decoder"
            default n

        config NXP_AUDIO_VOICE_COMPONENTS_OPUS_OGG
            bool "Enables OPUS OGG frame"
            default n

        config NXP_AUDIO_VOICE_COMPONENTS_OPUSFILE
            bool "Enables Opusfile"
            default n
    endmenu

    menu "Libraries"
        config NXP_AUDIO_VOICE_COMPONENTS_SSRC
            bool "Enables SSRC library"
            default n

        config NXP_AUDIO_VOICE_COMPONENTS_ASRC
            bool "Enables ASRC library"
            default n
    endmenu
endmenu # NXP audio voice libraries
```
